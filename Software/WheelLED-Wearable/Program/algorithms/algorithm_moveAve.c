/*====================================================================================================*/
/*====================================================================================================*/
#include "drivers\stm32f1_system.h"

#include "algorithm_moveAve.h"
/*====================================================================================================*/
/*====================================================================================================*
**函數 : MoveAve_SMA
**功能 : Simple Moving Average
**輸入 : NewData, MoveAve_FIFO, SampleLen
**輸出 : AveData
**使用 : MoveAve_SMA(NewData, MoveAve_FIFO, SampleLen);
**====================================================================================================*/
/*====================================================================================================*/
int16_t MoveAve_SMA( int16_t NewData, int16_t *MoveAve_FIFO, uint16_t SampleLen )
{
  uint8_t i = 0;
  int16_t AveData = 0;
  int32_t MoveAve_Sum = 0;

  for(i = 0; i < SampleLen-1; i++)              // 陣列移動
    MoveAve_FIFO[i] = MoveAve_FIFO[i+1];
  MoveAve_FIFO[SampleLen-1] = NewData;          // 加入新數據
  for(i = 0; i < SampleLen; i++)                // 求和
    MoveAve_Sum += MoveAve_FIFO[i];
  AveData = (int16_t)(MoveAve_Sum / SampleLen); // 計算平均值

  return AveData;
}
/*====================================================================================================*/
/*====================================================================================================*
**函數 : MoveAve_WMA
**功能 : Weighted Moving Average
**輸入 : NewData, MoveAve_FIFO, SampleLen
**輸出 : AveData
**使用 : MoveAve_WMA(NewData, MoveAve_FIFO, SampleLen);
**====================================================================================================*/
/*====================================================================================================*/
int16_t MoveAve_WMA( int16_t NewData, int16_t *MoveAve_FIFO, uint16_t SampleLen )
{
  uint8_t i = 0;
  int16_t AveData = 0;
  uint16_t SampleSum = 0;
  int32_t MoveAve_Sum = 0;

  for(i = 0; i < SampleLen-1; i++)                // 陣列移動
    MoveAve_FIFO[i] = MoveAve_FIFO[i+1];
  MoveAve_FIFO[SampleLen-1] = NewData;            // 加入新數據
  for(i = 0; i < SampleLen; i++)                  // 求和 & 加權
    MoveAve_Sum += MoveAve_FIFO[i] * (i+1);
  SampleSum = (SampleLen * (SampleLen + 1)) / 2;  // 計算加權除數
  AveData = (int16_t)(MoveAve_Sum / SampleSum);   // 計算平均值

  return AveData;
}
/*====================================================================================================*/
/*====================================================================================================*
**函數 : MoveAve_EMA
**功能 : Exponential Moving Average
**輸入 : NewData, MoveAve_FIFO, SampleLen
**輸出 : AveData
**使用 : MoveAve_EMA(NewData, MoveAve_FIFO, SampleLen);
**====================================================================================================*/
/*====================================================================================================*/

/*====================================================================================================*/
/*====================================================================================================*/
